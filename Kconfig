## Kconfig
```kconfig
menu "Luban-Lite HMI Framework"
config AIC_HMI_APP
    bool "Enable the Luban-Lite HMI application"
    default n
    depends on LPKG_USING_LVGL && LVGL_V_9 && LPKG_MPP
    help
      Build the selected Product with the SDK LVGL 9 display and input ports.
config AIC_HMI_PRODUCT_ROOT
    string "Product root for the firmware build"
    default ""
    depends on AIC_HMI_APP
    help
      Product directory relative to this application (for example products/<id>), or an
      absolute path. A firmware image contains exactly one Product, so an empty value stops
      the build. The HMI_PRODUCT_ROOT environment variable overrides this setting.

if AIC_HMI_APP

config AIC_HMI_DRAW_GE2D
    bool "Let LVGL draw widgets with the GE2D engine"
    default y
    help
      The SDK LVGL draws fills, images and layers with GE2D when it is enabled. The UI renders
      straight into the two scan-out buffers (direct mode), so CPU and GE2D drawing share one
      buffer, and the SDK GE2D draw unit invalidates the CPU cache over the area it draws without
      writing the CPU's pixels back first. That is a risk for artefacts, not a confirmed fault:
      turn this off to draw with the CPU only when comparing a visual glitch on the board.

menu "Board resources"
config AIC_HMI_CAN0_DEVICE
    string "CAN device behind logical bus CAN0"
    default "can0"
    help
      Products address buses by role (HMI_BUS_CAN0/CAN1); the board decides which CAN
      controller carries each role. A bus is only opened when the Product routes, sends
      periodic frames.
config AIC_HMI_CAN1_DEVICE
    string "CAN device behind logical bus CAN1"
    default "can1"
config AIC_HMI_DISPLAY_EXCLUSIVE
    bool "UI layer owns the display (video layer and extra UI rectangles off)"
    default y
    help
      Turns off the video layer and the extra UI rectangles, forces global alpha 255 and
      disables the colour key before LVGL starts. Say n when the Product shows camera or video
      on the video layer and manages layer alpha itself.
config AIC_HMI_BACKLIGHT
    bool "Drive the panel backlight from the brightness setting"
    default y
    depends on AIC_PWM_BACKLIGHT
    help
      Uses the SDK panel backlight channel (AIC_PWM_BACKLIGHT_CHANNEL) and re-applies the
      brightness setting (10..100) whenever it changes, verifying the PWM register readback.
      Say n when the Product controls the backlight itself (for example from a light sensor).
config AIC_HMI_BACKLIGHT_PERIOD_NS
    int "Backlight PWM period in ns"
    default 20000
    depends on AIC_HMI_BACKLIGHT
config AIC_HMI_BACKLIGHT_FLOOR_PERCENT
    int "Backlight duty at brightness 0, in percent"
    default 10
    range 0 100
    depends on AIC_HMI_BACKLIGHT
    help
      Duty = floor + brightness * (100 - floor) / 100. A floor keeps panels from going dark
      at the lowest settings.
endmenu

config AIC_HMI_VERSION_SEQUENCE
    int "Fixed daily build number V<n> (0 = automatic)"
    default 0
    range 0 99
    help
      Automatic numbering keeps the number while the sources and configuration are unchanged
      and adds one when they change. A value from 1 to 99 fixes the number instead. The
      HMI_VERSION_SEQUENCE environment variable overrides this setting for one build.
config AIC_HMI_WATCHDOG
    bool "Supervise Product execution with the hardware watchdog"
    default y
    help
      Arm the on-chip watchdog once the runtime starts. A Product may opt in to UI supervision
      after its first successful presentation. A stalled owner withholds the watchdog feed.
      Boards without a "wdt" device and the startup phase are never reset. Thresholds are
      board budgets in platform/rtthread/hmi_watchdog_budget.h.
config AIC_HMI_BLACKBOX
    bool "Record runtime diagnostics on a mounted TF card"
    depends on RT_USING_DFS && DFS_USING_POSIX && RT_USING_DFS_ELMFAT && !RT_USING_SMP
    default n
config AIC_HMI_BLACKBOX_DEVICE
    string "Black box block device"
    depends on AIC_HMI_BLACKBOX
    default "sd1"
config AIC_HMI_BLACKBOX_MOUNT
    string "Black box mount path"
    depends on AIC_HMI_BLACKBOX
    default "/sdcard"
config AIC_HMI_DISPLAY_GAMMA
    int "Display gamma in percent (100 = display engine default, no correction)"
    default 100
    range 50 300
    help
      Loads a per-channel gamma curve into the display engine once the display has started, to
      compensate panels that look washed out next to the simulator. Values above 100 darken the
      mid-tones and make mixed colours more saturated; black, white and the pure primaries stay
      put. The SDK colour adjustment (brightness/contrast/saturation) only affects the video
      layer, so it cannot change the LVGL picture. Bench values found with a panel tuning tool
      (for example hmi_color from Luban-Lite Display Lab) are set here.
config AIC_HMI_DISPLAY_CCM
    string "Display CCM table, 12 taps (empty = display engine default)"
    default ""
    help
      Loads a 3x4 colour-correction matrix into the display engine once the display has started:
      three Q8 gains and one 9-bit offset per output row (red, green, blue). Taps are decimal or
      hex with 0x / a leading 0 (two's complement, 0xFFD8 = -40), so the table printed by
      Display Lab's hmi_color ccm can be pasted directly, for example the identity matrix:
        "0x0100 0x0000 0x0000 0x0000 0x0000 0x0100 0x0000 0x0000 0x0000 0x0000 0x0100 0x0000"
      An empty value keeps the display engine default (identity, no correction).
config AIC_HMI_EXTRA_COMPONENTS
    string "Extra components linked into the firmware"
    default ""
    help
      Space-separated directories, relative to this application, each with a SConscript that
      returns a DefineGroup, for example ../luban-lite-display-lab for the Luban-Lite Display
      Lab bench tools. Keep them inside the SDK tree so their objects land in output/. A listed
      directory without a SConscript stops the build. The HMI_EXTRA_COMPONENTS environment
      variable overrides this setting for one build. Release firmware lists none.

endif
endmenu
```
